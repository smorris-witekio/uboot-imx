## board/freescale/mt_connect/Kconfig
```kconfig
if TARGET_IMX8MM_EVK || TARGET_IMX8MM_DDR4_EVK

config SYS_BOARD
	default "mt_connect"

config SYS_VENDOR
	default "freescale"

config SYS_CONFIG_NAME
	default "mt_connect"

config IMX_CONFIG
	default "board/freescale/mt_connect/mt_connect.cfg"

endif
```

## board/multitracks/mt-connect/Kconfig
```kconfig
if TARGET_IMX8MM_EVK || TARGET_IMX8MM_DDR4_EVK

config SYS_BOARD
	default "mt-connect"

config SYS_VENDOR
	default "multitracks"

config SYS_CONFIG_NAME
	default "imx8mm_evk"

config IMX_CONFIG
	default "board/multitracks/mt-connect/imximage-8mm.cfg"

endif
```
